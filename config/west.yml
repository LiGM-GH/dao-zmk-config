## config/west.yml
```yaml
manifest:
  remotes:
    - name: zmkfirmware
      url-base: https://github.com/zmkfirmware
  projects:
    - name: zmk
      remote: zmkfirmware
      revision: 7d5aa0c0bf7283ce484f467338c7e04ff1f7cf25
      import: app/west.yml
  self:
    path: config
```
